## esp32-gateway/main/Kconfig.projbuild
```kconfig
menu "Gateway Configuration"

    menu "SoftAP Configuration"

        config ESP_WIFI_AP_SSID
            string "WiFi AP SSID"
            default "Elmot-Oscilloscope"
            help
                SSID of the soft-AP.

        config ESP_WIFI_AP_PASSWORD
            string "WiFi AP Password"
            default ""
            help
                WiFi password (empty = open).

        config ESP_WIFI_AP_CHANNEL
            int "WiFi AP Channel"
            range 1 14
            default 1

        config ESP_MAX_STA_CONN_AP
            int "Max STA connections"
            default 4
    endmenu

    menu "STA Configuration"

        config ESP_WIFI_REMOTE_AP_SSID
            string "WiFi STA SSID"
            default "mywifi"

        config ESP_WIFI_REMOTE_AP_PASSWORD
            string "WiFi STA Password"
            default "mypassword"

        config ESP_MAXIMUM_STA_RETRY
            int "Max STA retry count"
            default 5

        choice ESP_WIFI_SCAN_AUTH_MODE_THRESHOLD
            prompt "Scan auth mode threshold"
            default ESP_WIFI_AUTH_WPA2_PSK

            config ESP_WIFI_AUTH_OPEN
                bool "OPEN"
            config ESP_WIFI_AUTH_WEP
                bool "WEP"
            config ESP_WIFI_AUTH_WPA_PSK
                bool "WPA PSK"
            config ESP_WIFI_AUTH_WPA2_PSK
                bool "WPA2 PSK"
            config ESP_WIFI_AUTH_WPA_WPA2_PSK
                bool "WPA/WPA2 PSK"
            config ESP_WIFI_AUTH_WPA3_PSK
                bool "WPA3 PSK"
            config ESP_WIFI_AUTH_WPA2_WPA3_PSK
                bool "WPA2/WPA3 PSK"
        endchoice
        config OSC_TX_POWER_TASK
            bool "Adjust TX power by RSSI"
            default y
            help
                Periodically read STA RSSI and reduce WiFi transmit power
                when signal is strong (to save power and reduce interference).
    endmenu

    menu "LED Configuration"

        config LED_GPIO
            int "RGB LED GPIO pin"
            default 2
            range 0 48
            help
                GPIO pin connected to the WS2812 RGB LED data line.
                Common values: 2 (M5Stamp-C3U.
    endmenu

	menu "UART Configuration"

        config OSC_UART_TX
            int "External UART TX GPIO pin"
            default 6
            range 0 48

        config OSC_UART_RX
            int "External UART RX GPIO pin"
            default 7
            range 0 48
    endmenu

endmenu
```

## esp32-gateway/sdkconfig.defaults
```kconfig
CONFIG_IDF_TARGET="esp32c3"
CONFIG_PARTITION_TABLE_CUSTOM=y
CONFIG_PARTITION_TABLE_CUSTOM_FILENAME="partition_table_2mb_huge_app.csv"
CONFIG_HTTPD_WS_SUPPORT=y
CONFIG_LWIP_LOCAL_HOSTNAME="f-scope.local"
CONFIG_LWIP_MAX_SOCKETS=50

# WiFi AP defaults
CONFIG_ESP_WIFI_AP_CHANNEL=1
CONFIG_ESP_MAX_STA_CONN_AP=4
CONFIG_ESP_MAXIMUM_STA_RETRY=5

CONFIG_ESP_WIFI_AUTH_WPA2_PSK=y

# BLE / NimBLE
CONFIG_BT_ENABLED=y
CONFIG_BT_NIMBLE_ENABLED=y
CONFIG_BT_NIMBLE_MAX_CONNECTIONS=3
CONFIG_BT_NIMBLE_LL_CFG_FEAT_LE_2M_PHY=y
CONFIG_BT_CTRL_BLE_LLCP_PHY_UPDATE=y
CONFIG_BT_CTRL_BLE_LLCP_CONN_UPDATE=y
```
